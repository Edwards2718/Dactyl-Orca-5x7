## config/boards/shields/dactyl_orca_5x7/Kconfig.defconfig
```kconfig
if SHIELD_DACTYL_ORCA_5x7

    config ZMK_KEYBOARD_NAME
        default "Dactyl Orca 5x7"

endif
```

## config/boards/shields/dactyl_orca_5x7/Kconfig.shield
```kconfig
config SHIELD_DACTYL_ORCA_5x7
    def_bool $(shields_list_contains,dactyl_orca_5x7)
```
